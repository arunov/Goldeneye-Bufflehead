## security/gebh/Kconfig
```kconfig
config SECURITY_GEBH
	bool "Goldeneye Bufflehead Role-based Access Control Support"
	help
	  This selects Goldeneye Bufflehead Role-based Access Control security.
```

## security/rbac/Kconfig
```kconfig
config SECURITY_RBAC
	bool "Role-based Access Control Support"
	help
	  This selects Role-based Access Control security.
```
